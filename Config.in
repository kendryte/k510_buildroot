## Config.in
```kconfig
source "$BR2_EXTERNAL_K510_PATH/package/riscv-pk-k510/Config.in"
source "$BR2_EXTERNAL_K510_PATH/package/riscv-tinymembench/Config.in"
source "$BR2_EXTERNAL_K510_PATH/package/video_lib/Config.in"
source "$BR2_EXTERNAL_K510_PATH/package/opencv4/Config.in"
source "$BR2_EXTERNAL_K510_PATH/package/nncase_linux_runtime/Config.in"
#source "$BR2_EXTERNAL_K510_PATH/package/nncase_demo/Config.in"
source "$BR2_EXTERNAL_K510_PATH/package/libdisp/Config.in"
source "$BR2_EXTERNAL_K510_PATH/package/drm_demo/Config.in"
source "$BR2_EXTERNAL_K510_PATH/package/lvgl/Config.in"
source "$BR2_EXTERNAL_K510_PATH/package/twod_demo/Config.in"
source "$BR2_EXTERNAL_K510_PATH/package/encode_app/Config.in"
source "$BR2_EXTERNAL_K510_PATH/package/dsp_app_new/Config.in"
source "$BR2_EXTERNAL_K510_PATH/package/k510_evb_test/Config.in"
source "$BR2_EXTERNAL_K510_PATH/package/dsp_log/Config.in"
source "$BR2_EXTERNAL_K510_PATH/package/venc_lib/Config.in"
source "$BR2_EXTERNAL_K510_PATH/package/alsa_demo/Config.in"
source "$BR2_EXTERNAL_K510_PATH/package/ffmpeg_canaan/Config.in"
source "$BR2_EXTERNAL_K510_PATH/package/audio3a_lib/Config.in"
source "$BR2_EXTERNAL_K510_PATH/package/mediactl_lib/Config.in"
source "$BR2_EXTERNAL_K510_PATH/package/isp-tuningd/Config.in"
source "$BR2_EXTERNAL_K510_PATH/package/mailbox_demo/Config.in"
source "$BR2_EXTERNAL_K510_PATH/package/dsp_scheduler/Config.in"
source "$BR2_EXTERNAL_K510_PATH/package/live555_canaan/Config.in"
source "$BR2_EXTERNAL_K510_PATH/package/ai/Config.in"
source "$BR2_EXTERNAL_K510_PATH/package/client/Config.in"
source "$BR2_EXTERNAL_K510_PATH/package/server/Config.in"
source "$BR2_EXTERNAL_K510_PATH/package/crypto/Config.in"
source "$BR2_EXTERNAL_K510_PATH/package/trng/Config.in"
source "$BR2_EXTERNAL_K510_PATH/package/pwm/Config.in"
source "$BR2_EXTERNAL_K510_PATH/package/rtc/Config.in"
source "$BR2_EXTERNAL_K510_PATH/package/uart/Config.in"
source "$BR2_EXTERNAL_K510_PATH/package/watchdog/Config.in"
source "$BR2_EXTERNAL_K510_PATH/package/write_read_file/Config.in"
source "$BR2_EXTERNAL_K510_PATH/package/wifi/Config.in"
source "$BR2_EXTERNAL_K510_PATH/package/gpio_keys/Config.in"
source "$BR2_EXTERNAL_K510_PATH/package/hello_world/Config.in"
source "$BR2_EXTERNAL_K510_PATH/package/librtmp/Config.in"
source "$BR2_EXTERNAL_K510_PATH/package/aws_iot_test/Config.in"
```

## configs/k510_crb_lp3_v1_2_defconfig
```kconfig
BR2_riscv=y
BR2_DL_DIR="$(TOPDIR)/../dl"
BR2_JLEVEL=5
BR2_GLOBAL_PATCH_DIR="$(TOPDIR)/../package/patches"
BR2_TOOLCHAIN_EXTERNAL=y
BR2_TOOLCHAIN_EXTERNAL_PATH="$(TOPDIR)/../toolchain/nds64le-linux-glibc-v5d"
BR2_TOOLCHAIN_EXTERNAL_GCC_7=y
BR2_TOOLCHAIN_EXTERNAL_HEADERS_4_17=y
BR2_TOOLCHAIN_EXTERNAL_CUSTOM_GLIBC=y
BR2_TOOLCHAIN_EXTERNAL_CXX=y
BR2_TOOLCHAIN_EXTERNAL_OPENMP=y
BR2_ROOTFS_SKELETON_CUSTOM=y
BR2_ROOTFS_SKELETON_CUSTOM_PATH="$(TOPDIR)/../board/canaan/k510/k510_rootfs_skeleton"
BR2_ROOTFS_DEVICE_CREATION_DYNAMIC_MDEV=y
BR2_ROOTFS_DEVICE_TABLE=""
BR2_ROOTFS_POST_BUILD_SCRIPT="$(TOPDIR)/../board/canaan/k510/post_build.sh"
BR2_ROOTFS_POST_IMAGE_SCRIPT="$(TOPDIR)/../board/canaan/k510/post-image-crb_v1_2.sh"
BR2_LINUX_KERNEL=y
BR2_LINUX_KERNEL_CUSTOM_VERSION=y
BR2_LINUX_KERNEL_CUSTOM_VERSION_VALUE="4.17"
BR2_LINUX_KERNEL_DEFCONFIG="k510"
BR2_LINUX_KERNEL_VMLINUX=y
BR2_PACKAGE_BUSYBOX_CONFIG="$(TOPDIR)/../board/canaan/k510/k510_busybox.config"
BR2_PACKAGE_ALSA_UTILS=y
BR2_PACKAGE_ALSA_UTILS_ALSACONF=y
BR2_PACKAGE_ALSA_UTILS_ACONNECT=y
BR2_PACKAGE_ALSA_UTILS_ALSALOOP=y
BR2_PACKAGE_ALSA_UTILS_ALSAUCM=y
BR2_PACKAGE_ALSA_UTILS_ALSATPLG=y
BR2_PACKAGE_ALSA_UTILS_AMIDI=y
BR2_PACKAGE_ALSA_UTILS_AMIXER=y
BR2_PACKAGE_ALSA_UTILS_APLAY=y
BR2_PACKAGE_ALSA_UTILS_APLAYMIDI=y
BR2_PACKAGE_ALSA_UTILS_ARECORDMIDI=y
BR2_PACKAGE_ALSA_UTILS_ASEQDUMP=y
BR2_PACKAGE_ALSA_UTILS_ASEQNET=y
BR2_PACKAGE_ALSA_UTILS_BAT=y
BR2_PACKAGE_ALSA_UTILS_IECSET=y
BR2_PACKAGE_ALSA_UTILS_SPEAKER_TEST=y
BR2_PACKAGE_STRESS_NG=y
BR2_PACKAGE_TINYMEMBENCH=y
BR2_PACKAGE_DOSFSTOOLS=y
BR2_PACKAGE_DOSFSTOOLS_FSCK_FAT=y
BR2_PACKAGE_DOSFSTOOLS_MKFS_FAT=y
BR2_PACKAGE_E2FSPROGS=y
BR2_PACKAGE_E2FSPROGS_RESIZE2FS=y
BR2_PACKAGE_MTD=y
BR2_PACKAGE_MTD_MKFSUBIFS=y
BR2_PACKAGE_MTD_TESTS=y
BR2_PACKAGE_MTD_FLASH_READTEST=y
BR2_PACKAGE_MTD_FLASH_SPEED=y
BR2_PACKAGE_MTD_FLASH_STRESS=y
BR2_PACKAGE_MTD_FLASH_TORTURE=y
BR2_PACKAGE_MTD_INTEGCK=y
BR2_PACKAGE_MTD_NANDBITERRS=y
BR2_PACKAGE_MTD_NANDPAGETEST=y
BR2_PACKAGE_MTD_NANDSUBPAGETEST=y
BR2_PACKAGE_MEMTESTER=y
BR2_PACKAGE_PARTED=y
BR2_PACKAGE_RNG_TOOLS=y
BR2_PACKAGE_PYTHON3=y
BR2_PACKAGE_PYTHON_PIP=y
BR2_PACKAGE_PYTHON_PYCRYPTODOMEX=y
BR2_PACKAGE_LIBDRM=y
BR2_PACKAGE_IPERF=y
BR2_PACKAGE_NTP=y
# BR2_PACKAGE_NTP_NTPD is not set
BR2_PACKAGE_NTP_NTPDATE=y
BR2_PACKAGE_TCPDUMP=y
BR2_PACKAGE_TCPDUMP_SMB=y
BR2_PACKAGE_WPA_SUPPLICANT=y
BR2_PACKAGE_WPA_SUPPLICANT_AP_SUPPORT=y
BR2_PACKAGE_WPA_SUPPLICANT_WIFI_DISPLAY=y
BR2_PACKAGE_WPA_SUPPLICANT_MESH_NETWORKING=y
BR2_PACKAGE_WPA_SUPPLICANT_AUTOSCAN=y
BR2_PACKAGE_WPA_SUPPLICANT_EAP=y
BR2_PACKAGE_WPA_SUPPLICANT_HOTSPOT=y
BR2_PACKAGE_WPA_SUPPLICANT_DEBUG_SYSLOG=y
BR2_PACKAGE_WPA_SUPPLICANT_WPS=y
BR2_PACKAGE_WPA_SUPPLICANT_WPA3=y
BR2_PACKAGE_WPA_SUPPLICANT_CLI=y
BR2_PACKAGE_WPA_SUPPLICANT_PASSPHRASE=y
BR2_PACKAGE_WPA_SUPPLICANT_DBUS=y
BR2_TARGET_ROOTFS_EXT2=y
BR2_TARGET_ROOTFS_EXT2_SIZE="512M"
BR2_TARGET_UBOOT=y
BR2_TARGET_UBOOT_BOARD_DEFCONFIG="k510_crb_lp3_v1_2"
BR2_PACKAGE_HOST_GENIMAGE=y
BR2_PACKAGE_HOST_PYTHON_CYTHON=y
BR2_PACKAGE_HOST_PYTHON_LXML=y
BR2_PACKAGE_HOST_PYTHON_SIX=y
BR2_PACKAGE_HOST_PYTHON_XLRD=y
BR2_PACKAGE_HOST_PYTHON3=y
BR2_PACKAGE_VIDEO_LIB=y
BR2_PACKAGE_OPENCV4=y
BR2_PACKAGE_NNCASE_LINUX_RUNTIME=y
BR2_PACKAGE_DRM_DEMO=y
BR2_PACKAGE_LVGL=y
BR2_PACKAGE_TWOD_DEMO=y
BR2_PACKAGE_ENCODE_APP=y
BR2_TARGET_BOARD_TYPE="crb"
BR2_PACKAGE_DSP_APP_NEW=y
BR2_TARGET_EVB_FIRMWARE_LOAD_ADD=0x1f000000
BR2_PACKAGE_K510_EVB_TEST=y
BR2_TARGET_K510_EVB_TEST_FFT_FIRMWARE=y
BR2_TARGET_K510_EVB_TEST_MAILBOX_FIRMWARE=y
BR2_TARGET_K510_EVB_TEST_SIMD_UMUL8_FIRMWARE=y
BR2_PACKAGE_DSP_LOG=y
BR2_PACKAGE_VENC_LIB=y
BR2_PACKAGE_ALSA_DEMO=y
BR2_PACKAGE_FFMPEG_CANAAN=y
BR2_PACKAGE_AUDIO3A_LIB=y
BR2_PACKAGE_MEDIACTL_LIB=y
BR2_PACKAGE_ISP_TUNINGD=y
BR2_PACKAGE_MAILBOX_DEMO=y
BR2_PACKAGE_DSP_SCHEDULER=y
BR2_PACKAGE_LIVE555_CANAAN=y
BR2_PACKAGE_LIBRTMP=y
BR2_PACKAGE_OPENSSL=y
BR2_PACKAGE_LIBOPENSSL=y
BR2_PACKAGE_AI=y
BR2_PACKAGE_CLIENT=y
BR2_PACKAGE_SERVER=y
BR2_PACKAGE_CRYPTO=y
BR2_PACKAGE_TRNG=y
BR2_PACKAGE_PWM=y
BR2_PACKAGE_RTC=y
BR2_PACKAGE_UART=y
BR2_PACKAGE_WATCHDOG=y
BR2_PACKAGE_WRITE_READ_FILE=y
BR2_PACKAGE_WIFI=y
BR2_PACKAGE_AWS_IOT_TEST=y
BR2_PACKAGE_GPIO_KEYS=y
BR2_PACKAGE_RAPIDJSON=y
```

## package/ai/Config.in
```kconfig
menu "ai demo"
config BR2_PACKAGE_AI
	bool "ai demo"
	depends on BR2_riscv
	help
	  k510 ai demo

config BR2_PACKAGE_AI_KMODEL_DATA_SITE
	string "ai kmodel data mode site"
	depends on BR2_PACKAGE_AI
	help
	  ai kmodel data mode site

endmenu
```

## package/alsa_demo/Config.in
```kconfig
config BR2_PACKAGE_ALSA_DEMO
	bool "alsa_demo"
	depends on BR2_riscv
	help
	  k510 ALSA for demo
```

## package/audio3a_lib/Config.in
```kconfig
config BR2_PACKAGE_AUDIO3A_LIB
	bool "audio3a lib"
	depends on BR2_riscv
	help
	  k510 audio3a lib
```

## package/aws_iot_test/Config.in
```kconfig
config BR2_PACKAGE_AWS_IOT_TEST
	bool "aws_iot_test"
	depends on BR2_riscv
	help
	  k510 aws_iot_test demo
```

## package/client/Config.in
```kconfig
config BR2_PACKAGE_CLIENT
	bool "client"
	depends on BR2_riscv
	help
	  k510 client demo
```

## package/crypto/Config.in
```kconfig
config BR2_PACKAGE_CRYPTO
	bool "crypto"
	depends on BR2_riscv
	help
	  k510 crypto demo
```

## package/drm_demo/Config.in
```kconfig
config BR2_PACKAGE_DRM_DEMO
	bool "drm_demo"
	depends on BR2_riscv
	select BR2_PACKAGE_LIBDISP
	help
	  k510 drm demo
```

## package/dsp_app_new/Config.in
```kconfig
config BR2_PACKAGE_DSP_APP_NEW
	bool "dsp_app_new"
	depends on BR2_riscv
	help
	  k510 dsp demo, dsp firmware load address is 0x5800000(88M~96M)

	  
if BR2_PACKAGE_DSP_APP_NEW

config BR2_TARGET_EVB_FIRMWARE_LOAD_ADD
    hex "dsp firmware load address"
    default 0x0000000
    help
      dsp firmware load address.
	  
endif
```

## package/dsp_log/Config.in
```kconfig
config BR2_PACKAGE_DSP_LOG
    bool "dsp_log"
    depends on BR2_riscv
    help 
        k510 share memory, it will start automatically when booting up.
```

## package/dsp_scheduler/Config.in
```kconfig
config BR2_PACKAGE_DSP_SCHEDULER
	bool "dsp scheduler"
	depends on BR2_riscv
	depends on BR2_PACKAGE_AUDIO3A_LIB
	help
	  k510 dsp scheduler
	
config BR2_TARGET_BOARD_TYPE
	string "target board type"
	help
	  target board type

menuconfig BR2_PACKAGE_DSP_SCHEDULER
	bool "dsp scheduler"
	help
		"dsp scheduler tasks"

if BR2_PACKAGE_DSP_SCHEDULER

config BR2_PACKAGE_DSP_SCHEDULER_AUDIO3A_TASK
	bool "enable audio3a task"
	default y
	depends on BR2_PACKAGE_AUDIO3A_LIB
	help
		enable audio3a task

endif
```

## package/encode_app/Config.in
```kconfig
config BR2_PACKAGE_ENCODE_APP
	bool "encode app"
	depends on BR2_riscv
	depends on BR2_PACKAGE_VIDEO_LIB
	depends on BR2_PACKAGE_LIVE555_CANAAN
	depends on BR2_PACKAGE_VENC_LIB
	depends on BR2_PACKAGE_MEDIACTL_LIB
	help
	  k510 encode app
	
config BR2_TARGET_BOARD_TYPE
	string "target board type"
	help
	  target board type
```

## package/gpio_keys/Config.in
```kconfig
config BR2_PACKAGE_GPIO_KEYS
	bool "gpio keys"
	depends on BR2_riscv
	help
	  k510 gpio keys demo
```

## package/isp-tuningd/Config.in
```kconfig
config BR2_PACKAGE_ISP_TUNINGD
	bool "isp-tuningd"
	depends on BR2_riscv
	select BR2_PACKAGE_VENC_LIB
	select BR2_PACKAGE_LIBUV
	help
	  k510 ISP tuning daemon
```

## package/k510_evb_test/Config.in
```kconfig
config BR2_PACKAGE_K510_EVB_TEST
	bool "K510 evb test"
	depends on BR2_riscv
	help
	  k510 evb test

	  
if BR2_PACKAGE_K510_EVB_TEST
config BR2_TARGET_K510_EVB_TEST_FFT_FIRMWARE
	bool "FFT"
	help
	  K510 EVB TEST FFT.
endif

if BR2_PACKAGE_K510_EVB_TEST
config BR2_TARGET_K510_EVB_TEST_MAILBOX_FIRMWARE
	bool "MAILBOX_DEMO"
	help
		the demo of mailbox running on dsp 
endif

if BR2_PACKAGE_K510_EVB_TEST
config BR2_TARGET_K510_EVB_TEST_SIMD_UMUL8_FIRMWARE
	bool "SIMD_UMUL8_DEMO"
	help
		the demo of simd_umul8 running on dsp 
endif
```

## package/k510_mpp_sdk/Config.in
```kconfig
config BR2_PACKAGE_K510_MPP_SDK
	bool "k510_mpp_sdk"
	depends on BR2_riscv
	help
	  k510 mpp sdk
```

## package/libdisp/Config.in
```kconfig
config BR2_PACKAGE_LIBDISP
	bool "libdisp"
	depends on BR2_riscv
	help
	  k510 display lib
```

## package/librtmp/Config.in
```kconfig
config BR2_PACKAGE_LIBRTMP
	bool "librtmp"
    depends on BR2_riscv
	help
	  librtmp
```

## package/live555_canaan/Config.in
```kconfig
config BR2_PACKAGE_LIVE555_CANAAN
	bool "live555"
    depends on BR2_riscv
	help
	  LIVE555 Streaming Media forms a set of C++ libraries for
	  multimedia streaming, using open standard protocols
	  (RTP/RTCP, RTSP, SIP).

	  http://www.live555.com/liveMedia/
```

## package/lvgl/Config.in
```kconfig
config BR2_PACKAGE_LVGL
	bool "lvgl"
	depends on BR2_riscv
	select BR2_PACKAGE_LIBDISP
	help
	  lvgl
```

## package/mailbox_demo/Config.in
```kconfig
config BR2_PACKAGE_MAILBOX_DEMO
    bool "mailbox_demo"
    depends on BR2_riscv
    help 
        k510 mailbox demo, It shows the simple communication between cpu and dsp.
```

## package/mediactl_lib/Config.in
```kconfig
config BR2_PACKAGE_MEDIACTL_LIB
	bool "mediactl_lib"
	depends on BR2_riscv
	help
	  k510 mediactl lib for demo
```

## package/nncase_linux_runtime/Config.in
```kconfig
config BR2_PACKAGE_NNCASE_LINUX_RUNTIME
	bool "nncase linux runtime"
	depends on BR2_riscv
	help
	  nncase linux runtime, include the static library and header files, which are needed when compile GNNE demo programs.
```

## package/opencv4/Config.in
```kconfig
menuconfig BR2_PACKAGE_OPENCV4
	bool "opencv4"
	depends on BR2_TOOLCHAIN_HAS_ATOMIC
	depends on BR2_TOOLCHAIN_HAS_THREADS_NPTL
	depends on BR2_INSTALL_LIBSTDCPP
	depends on BR2_USE_WCHAR
	depends on !BR2_STATIC_LIBS # include dlfcn.h
	depends on !BR2_PACKAGE_OPENCV
	select BR2_PACKAGE_ZLIB
	select BR2_PACKAGE_FFMPEG_CANAAN
	help
	  OpenCV (Open Source Computer Vision) is a library of
	  programming functions for real time computer vision.

	  Note that the opencv_core module and the opencv_hal library
	  are always built and installed, not matter which other
	  modules are enabled below.

	  http://opencv.org/


comment "opencv4 needs a toolchain w/ C++, NPTL, wchar, dynamic library"
	depends on BR2_TOOLCHAIN_HAS_ATOMIC
	depends on !BR2_INSTALL_LIBSTDCPP || \
		!BR2_USE_WCHAR || \
		!BR2_TOOLCHAIN_HAS_THREADS_NPTL || \
		BR2_STATIC_LIBS
```
