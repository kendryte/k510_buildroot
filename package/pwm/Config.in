## package/riscv-pk-k510/Config.in
```kconfig
comment "riscv-pk needs a Linux kernel to be built"
	depends on BR2_riscv
	depends on !BR2_LINUX_KERNEL

config BR2_PACKAGE_RISCV_PK_K510
	bool "riscv-pk-k510"
	depends on BR2_riscv
	depends on BR2_LINUX_KERNEL
	default y if BR2_riscv
	help
	  riscv-pk for k510, which contains the bbl used by k510 linux kernel
```

## package/server/Config.in
```kconfig
config BR2_PACKAGE_SERVER
	bool "server"
	depends on BR2_riscv
	help
	  k510 server demo
```

## package/trng/Config.in
```kconfig
config BR2_PACKAGE_TRNG
	bool "trng"
	depends on BR2_riscv
	help
	  k510 trng demo
```

## package/twod_demo/Config.in
```kconfig
config BR2_PACKAGE_TWOD_DEMO
    bool "twod_demo"
    depends on BR2_riscv
    help 
        k510 twod demo, It shows the simple rotation and scaler.
```

## package/uart/Config.in
```kconfig
config BR2_PACKAGE_UART
	bool "uart"
	depends on BR2_riscv
	help
	  k510 uart_test demo
```

## package/venc_lib/Config.in
```kconfig
config BR2_PACKAGE_VENC_LIB
	bool "venc lib"
	depends on BR2_riscv
	help
	  k510 venc lib
```

## package/video_lib/Config.in
```kconfig
config BR2_PACKAGE_VIDEO_LIB
	bool "video_lib"
	depends on BR2_riscv
	help
	  k510 video lib for demo
```

## package/watchdog/Config.in
```kconfig
config BR2_PACKAGE_WATCHDOG
	bool "watchdog"
	depends on BR2_riscv
	help
	  k510 watchdog demo
```

## package/wifi/Config.in
```kconfig
config BR2_PACKAGE_WIFI
	bool "wifi demo"
	depends on BR2_riscv
	help
	  k510 wifi demo
```

## package/write_read_file/Config.in
```kconfig
config BR2_PACKAGE_WRITE_READ_FILE
	bool "write_read_file"
	depends on BR2_riscv
	help
	  k510 write_read_file demo
```
